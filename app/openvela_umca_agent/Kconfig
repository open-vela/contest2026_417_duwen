## app/openvela_umca_agent/Kconfig
```kconfig
config LVX_USE_DEMO_CONTEST2026_417_UMCA_AGENT
	bool "UMCA openvela demo agent"
	depends on UMCA
	depends on !UMCA_PROFILE_MINIMAL
	default n
	---help---
		Enable the UMCA demo application. The application is a thin host/runtime
		integration shell; UMCA protocol logic remains in the independent library.
```

## app/openvela_umca_gd32/Kconfig
```kconfig
config LVX_USE_DEMO_CONTEST2026_417_UMCA_GD32
	bool "UMCA GD32 UART node"
	default n
	depends on UMCA_PROFILE_DISCOVERY
	select UMCA_BUILD_UART
	---help---
		Build a single-context UMCA discovery node for GD32F470V-START. The
		default UMCA link is UART4 on PC12/TX and PD2/RX, exposed as
		/dev/ttyS1 when USART0 remains the NSH console. A device-path override
		can still be supplied at runtime for diagnostics.

if LVX_USE_DEMO_CONTEST2026_417_UMCA_GD32

config LVX_USE_DEMO_CONTEST2026_417_UMCA_GD32_PROGNAME
	string "Program name"
	default "umca_gd32"

config LVX_USE_DEMO_CONTEST2026_417_UMCA_GD32_PRIORITY
	int "Task priority"
	default 100

config LVX_USE_DEMO_CONTEST2026_417_UMCA_GD32_STACKSIZE
	int "Task stack size"
	default 6144

endif
```

## umca/Kconfig
```kconfig
config UMCA
	bool "Unified Modular Communication Architecture"
	default n
	---help---
		Enable the platform-independent UMCA core and its optional adapters.

if UMCA

choice UMCA_PROFILE
	prompt "UMCA profile"
	default UMCA_PROFILE_DISCOVERY

config UMCA_PROFILE_MINIMAL
	bool "Minimal"

config UMCA_PROFILE_DISCOVERY
	bool "Discovery"

config UMCA_PROFILE_CONTEST
	bool "Contest"

endchoice

config UMCA_BUILD_LOOPBACK
	bool "Loopback PHY"
	default y

config UMCA_MAX_PAYLOAD
	int "Maximum payload"
	default 256
	range 1 256

config UMCA_MAX_TOPICS
	int "Local topic capacity"
	default 16
	range 1 255

endif
```

## umca/openvela/Kconfig
```kconfig
config UMCA
	bool "Unified Modular Communication Architecture"
	default n
	---help---
		Enable the platform-independent UMCA core.

if UMCA

choice UMCA_PROFILE
	prompt "UMCA profile"
	default UMCA_PROFILE_DISCOVERY

config UMCA_PROFILE_MINIMAL
	bool "Minimal"

config UMCA_PROFILE_DISCOVERY
	bool "Discovery"

config UMCA_PROFILE_CONTEST
	bool "Contest"

endchoice

config UMCA_BUILD_LOOPBACK
	bool "Loopback PHY"
	default y

config UMCA_BUILD_UART
	bool "UART PHY"
	default n
	---help---
		Build the static UART byte-stream PHY adapter. The application supplies
		the platform UART read/write callbacks.

config LVX_USE_DEMO_CONTEST2026_417_UMCA_AGENT
	bool "UMCA openvela demo agent"
	depends on !UMCA_PROFILE_MINIMAL
	default n
	---help---
		Enable the Goldfish three-node UMCA service application.

endif
```
